## boards/arm/connectkit_nrf52840/Kconfig.board
```kconfig
#
# Copyright (c) 2016-2023 Makerdiary
#
# SPDX-License-Identifier: Apache-2.0
#

config BOARD_CONNECTKIT_NRF52840
    bool "NRF52840 CONNECT KIT"
    depends on SOC_NRF52840_QIAA
```

## boards/arm/connectkit_nrf52840/Kconfig.defconfig
```kconfig
#
# Copyright (c) 2016-2023 Makerdiary
#
# SPDX-License-Identifier: Apache-2.0
#

if BOARD_CONNECTKIT_NRF52840

config BOARD
    default "connectkit_nrf52840"

config BT_CTLR
    default BT

endif # BOARD_CONNECTKIT_NRF52840
```

## boards/arm/dongle_nrf52840/Kconfig
```kconfig
#
# Copyright (c) 2016-2023 Makerdiary
#
# SPDX-License-Identifier: Apache-2.0
#

if BOARD_DONGLE_NRF52840

config BOARD_ENABLE_DCDC
    bool "Enable DCDC mode"
    select SOC_DCDC_NRF52X
    default y

endif # BOARD_DONGLE_NRF52840
```

## boards/arm/dongle_nrf52840/Kconfig.board
```kconfig
#
# Copyright (c) 2016-2023 Makerdiary
#
# SPDX-License-Identifier: Apache-2.0
#

config BOARD_DONGLE_NRF52840
    bool "NRF52840 MDK USB DONGLE"
    depends on SOC_NRF52840_QIAA
```

## boards/arm/dongle_nrf52840/Kconfig.defconfig
```kconfig
#
# Copyright (c) 2016-2023 Makerdiary
#
# SPDX-License-Identifier: Apache-2.0
#

if BOARD_DONGLE_NRF52840

config BOARD
    default "dongle_nrf52840"

config BT_CTLR
    default BT

endif # BOARD_DONGLE_NRF52840
```

## samples/ble/hci_usb/sample.yaml
```yaml
sample:
  name: Bluetooth over USB sample
common:
  build_only: true
  integration_platforms:
    - connectkit_nrf52840
    - dongle_nrf52840
tests:
  sample.bluetooth.hci_usb: {}
  sample.bluetooth.hci_usb.device_next:
    extra_args: CONF_FILE="usbd_next_prj.conf"
```

## samples/ble/iso_broadcast/sample.yaml
```yaml
sample:
  name: Bluetooth ISO Broadcaster
common:
  build_only: true
  integration_platforms:
    - connectkit_nrf52840
    - dongle_nrf52840
tests:
  sample.bluetooth.iso_broadcast: {}
  sample.bluetooth.iso_broadcast.bt_ll_sw_split:
    extra_args: OVERLAY_CONFIG=overlay-bt_ll_sw_split.conf
```

## samples/ble/iso_receive/sample.yaml
```yaml
sample:
  name: Bluetooth Synchronized Receiver
common:
  build_only: true
  integration_platforms:
    - connectkit_nrf52840
    - dongle_nrf52840
tests:
  sample.bluetooth.iso_receive: {}
  sample.bluetooth.iso_receive.bt_ll_sw_split:
    extra_args: OVERLAY_CONFIG=overlay-bt_ll_sw_split.conf
```

## samples/openthread/coap_client/sample.yaml
```yaml
sample:
  description: Test CoAP communication in Thread network
  name: OpenThreadThread CoAP Client
common:
  build_only: true
  integration_platforms:
    - connectkit_nrf52840
    - dongle_nrf52840
tests:
  sample.openthread.coap_client: {}
  sample.openthread.coap_client.mtd:
    extra_args: OVERLAY_CONFIG=overlay-mtd.conf
  sample.openthread.coap_client.multiprotocol_ble:
    extra_args: OVERLAY_CONFIG=overlay-multiprotocol_ble.conf
  sample.openthread.coap_client.mtd.multiprotocol_ble:
    extra_args: OVERLAY_CONFIG=overlay-mtd.conf;overlay-multiprotocol_ble.conf
```

## samples/openthread/coap_server/sample.yaml
```yaml
sample:
  description: Test CoAP communication in Thread network
  name: OpenThread CoAP Server
common:
  build_only: true
  integration_platforms:
    - connectkit_nrf52840
    - dongle_nrf52840
tests:
  sample.openthread.coap_server: {}
```

## west.yml
```yaml
# Copyright (c) 2016-2023 Makerdiary
# SPDX-License-Identifier: Apache-2.0

manifest:
  self:
    path: connect-micro-project

  remotes:
    - name: makerdiary
      url-base: https://github.com/makerdiary
    - name: zephyrproject-rtos
      url-base: https://github.com/zephyrproject-rtos
    - name: nrfconnect
      url-base: https://github.com/nrfconnect

  projects:
    - name: sdk-nrf
      path: nrf
      remote: nrfconnect
      revision: v2.3.0-rc1
      import: true
```
