## sample.yaml
```
sample:
  description: Zigbee Light control - coordinator sample
  name: Zigbee Network coordinator
common:
  build_only: true
  integration_platforms:
    - connectkit_nrf52840
    - dongle_nrf52840
tests:
  sample.zigbee.network_coordinator: {}
```

## prj.conf
```kconfig
#
# Copyright (c) 2020 Nordic Semiconductor ASA
#
# SPDX-License-Identifier: LicenseRef-Nordic-5-Clause
#

CONFIG_UART_INTERRUPT_DRIVEN=y
CONFIG_SERIAL=y
CONFIG_GPIO=y

# Make sure printk is not printing to the UART console
CONFIG_CONSOLE=y
CONFIG_UART_CONSOLE=y

CONFIG_HEAP_MEM_POOL_SIZE=2048
CONFIG_MAIN_THREAD_PRIORITY=7

CONFIG_ZIGBEE=y
CONFIG_ZIGBEE_APP_UTILS=y
CONFIG_ZIGBEE_ROLE_COORDINATOR=y

# Enable DK LED and Buttons library
CONFIG_DK_LIBRARY=y

# This example requires more workqueue stack
CONFIG_SYSTEM_WORKQUEUE_STACK_SIZE=2048

# Enable nRF ECB driver
CONFIG_CRYPTO=y
CONFIG_CRYPTO_NRF_ECB=y
CONFIG_CRYPTO_INIT_PRIORITY=80

# Networking
CONFIG_NET_IPV6=n
CONFIG_NET_IP_ADDR_CHECK=n
CONFIG_NET_UDP=n
```

## boards/dongle_nrf52840.overlay
```dts
/*
 * Copyright (c) 2016-2023 Makerdiary
 *
 * SPDX-License-Identifier: Apache-2.0
 */

/ {
	chosen {
		ncs,zigbee-timer = &timer2;
	};
};

&timer2 {
	status = "okay";
};
```

## src/main.c
```c
/*
 * Copyright (c) 2020 Nordic Semiconductor ASA
 * Copyright (c) 2016-2023 Makerdiary
 *
 * SPDX-License-Identifier: LicenseRef-Nordic-5-Clause
 */

/** @file
 *  @brief Simple Zigbee network coordinator implementation
 */

#include <zephyr/kernel.h>
#include <zephyr/device.h>
#include <zephyr/logging/log.h>
#include <dk_buttons_and_leds.h>

#include <zboss_api.h>
#include <zb_mem_config_max.h>
#include <zigbee/zigbee_error_handler.h>
#include <zigbee/zigbee_app_utils.h>
#include <zb_nrf_platform.h>
#include "zb_range_extender.h"


#define RUN_STATUS_LED                         2
#define RUN_LED_BLINK_INTERVAL                 1000

/* Device endpoint, used to receive ZCL commands. */
#define ZIGBEE_COORDINATOR_ENDPOINT            10

/* Type of power sources available for the device.
 * For possible values see section 3.2.2.2.8 of ZCL specification.
 */
#define COORDINATOR_INIT_BASIC_POWER_SOURCE    ZB_ZCL_BASIC_POWER_SOURCE_DC_SOURCE

/* LED indicating that device successfully joined Zigbee network. */
#ifdef CONFIG_BOARD_DONGLE_NRF52840
#define ZIGBEE_NETWORK_STATE_LED               0
#else
#define ZIGBEE_NETWORK_STATE_LED               3
#endif /* defined CONFIG_BOARD_DONGLE_NRF52840 */

/* LED used for device identification. */
#define IDENTIFY_LED                           1

/* Button which reopens the Zigbee Network. */
#define KEY_ZIGBEE_NETWORK_REOPEN              DK_BTN2_MSK

/* Button used to enter the Identify mode. */
#define IDENTIFY_MODE_BUTTON                   DK_BTN1_MSK

/* If set to ZB_TRUE then device will not open the network after forming or reboot. */
#define ZIGBEE_MANUAL_STEERING                 ZB_FALSE

#define ZIGBEE_PERMIT_LEGACY_DEVICES           ZB_FALSE

#ifndef ZB_COORDINATOR_ROLE
#error Define ZB_COORDINATOR_ROLE to compile coordinator source code.
#endif

/* Button to start Factory Reset */
#define FACTORY_RESET_BUTTON IDENTIFY_MODE_BUTTON

LOG_MODULE_REGISTER(app, LOG_LEVEL_INF);

/* Main application customizable context.
 * Stores all settings and static values.
 */
struct zb_device_ctx {
    zb_zcl_basic_attrs_t basic_attr;
    zb_zcl_identify_attrs_t identify_attr;
};

/* Zigbee device application context storage. */
static struct zb_device_ctx dev_ctx;

ZB_ZCL_DECLARE_IDENTIFY_ATTRIB_LIST(
    identify_attr_list,
    &dev_ctx.identify_attr.identify_time);

ZB_ZCL_DECLARE_BASIC_ATTRIB_LIST(
    basic_attr_list,
    &dev_ctx.basic_attr.zcl_version,
    &dev_ctx.basic_attr.power_source);

ZB_DECLARE_RANGE_EXTENDER_CLUSTER_LIST(
    nwk_coordinator_clusters,
    basic_attr_list,
    identify_attr_list);

ZB_DECLARE_RANGE_EXTENDER_EP(
    nwk_coordinator_ep,
    ZIGBEE_COORDINATOR_ENDPOINT,
    nwk_coordinator_clusters);

ZBOSS_DECLARE_DEVICE_CTX_1_EP(
    nwk_coordinator,
    nwk_coordinator_ep);


/**@brief Function for initializing all clusters attributes. */
static void app_clusters_attr_init(void)
{
    /* Basic cluster attributes data. */
    dev_ctx.basic_attr.zcl_version = ZB_ZCL_VERSION;
    dev_ctx.basic_attr.power_source = COORDINATOR_INIT_BASIC_POWER_SOURCE;

    /* Identify cluster attributes data. */
    dev_ctx.identify_attr.identify_time = ZB_ZCL_IDENTIFY_IDENTIFY_TIME_DEFAULT_VALUE;
}

/**@brief Function to toggle the identify LED.
 *
 * @param  bufid  Unused parameter, required by ZBOSS scheduler API.
 */
static void toggle_identify_led(zb_bufid_t bufid)
{
    static int blink_status;

    dk_set_led(IDENTIFY_LED, (++blink_status) % 2);
    ZB_SCHEDULE_APP_ALARM(toggle_identify_led, bufid, ZB_MILLISECONDS_TO_BEACON_INTERVAL(100));
}

/**@brief Function to handle identify notification events on the first endpoint.
 *
 * @param  bufid  Unused parameter, required by ZBOSS scheduler API.
 */
static void identify_cb(zb_bufid_t bufid)
{
    zb_ret_t zb_err_code;

    if (bufid) {
        /* Schedule a self-scheduling function that will toggle the LED. */
        ZB_SCHEDULE_APP_CALLBACK(toggle_identify_led, bufid);
    } else {
        /* Cancel the toggling function alarm and turn off LED. */
        zb_err_code = ZB_SCHEDULE_APP_ALARM_CANCEL(toggle_identify_led, ZB_ALARM_ANY_PARAM);
        ZVUNUSED(zb_err_code);

        dk_set_led(IDENTIFY_LED, 0);
    }
}

/**@brief Starts identifying the device.
 *
 * @param  bufid  Unused parameter, required by ZBOSS scheduler API.
 */
static void start_identifying(zb_bufid_t bufid)
{
    ZVUNUSED(bufid);

    if (ZB_JOINED()) {
        /* Check if endpoint is in identifying mode,
         * if not, put desired endpoint in identifying mode.
         */
        if (dev_ctx.identify_attr.identify_time ==
            ZB_ZCL_IDENTIFY_IDENTIFY_TIME_DEFAULT_VALUE) {

            zb_ret_t zb_err_code = zb_bdb_finding_binding_target(
                ZIGBEE_COORDINATOR_ENDPOINT);

            if (zb_err_code == RET_OK) {
                LOG_INF("Enter identify mode");
            } else if (zb_err_code == RET_INVALID_STATE) {
                LOG_WRN("RET_INVALID_STATE - Cannot enter identify mode");
            } else {
                ZB_ERROR_CHECK(zb_err_code);
            }
        } else {
            LOG_INF("Cancel identify mode");
            zb_bdb_finding_binding_target_cancel();
        }
    } else {
        LOG_WRN("Device not in a network - cannot enter identify mode");
    }
}

/**@brief Callback used in order to visualise network steering period.
 *
 * @param[in]   param   Not used. Required by callback type definition.
 */
static void steering_finished(zb_uint8_t param)
{
    ARG_UNUSED(param);

    LOG_INF("Network steering finished");
    dk_set_led_off(ZIGBEE_NETWORK_STATE_LED);
}

/**@brief Callback for button events.
 *
 * @param[in]   button_state  Bitmask containing buttons state.
 * @param[in]   has_changed   Bitmask containing buttons that has changed their state.
 */
static void button_changed(uint32_t button_state, uint32_t has_changed)
{
    /* Calculate bitmask of buttons that are pressed and have changed their state. */
    uint32_t buttons = button_state & has_changed;
    zb_bool_t comm_status;

    if (buttons & KEY_ZIGBEE_NETWORK_REOPEN) {
        (void)(ZB_SCHEDULE_APP_ALARM_CANCEL(steering_finished, ZB_ALARM_ANY_PARAM));

        comm_status = bdb_start_top_level_commissioning(ZB_BDB_NETWORK_STEERING);
        if (comm_status) {
            LOG_INF("Top level commissioning restated");
        } else {
            LOG_INF("Top level commissioning hasn't finished yet!");
        }
    }

    if (IDENTIFY_MODE_BUTTON & has_changed) {
        if (IDENTIFY_MODE_BUTTON & button_state) {
            /* Button changed its state to pressed */
        } else {
            /* Button changed its state to released */
            if (was_factory_reset_done()) {
                /* The long press was for Factory Reset */
                LOG_DBG("After Factory Reset - ignore button release");
            } else   {
                /* Button released before Factory Reset */

                /* Start identification mode */
                ZB_SCHEDULE_APP_CALLBACK(start_identifying, 0);
            }
        }
    }

    check_factory_reset_button(button_state, has_changed);
}

/**@brief Function for initializing LEDs and Buttons. */
static void configure_gpio(void)
{
    int err;

    err = dk_buttons_init(button_changed);
    if (err) {
        LOG_ERR("Cannot init buttons (err: %d)", err);
    }

    err = dk_leds_init();
    if (err) {
        LOG_ERR("Cannot init LEDs (err: %d)", err);
    }
}

/**@brief Zigbee stack event handler.
 *
 * @param[in]   bufid   Reference to the Zigbee stack buffer used to pass signal.
 */
void zboss_signal_handler(zb_bufid_t bufid)
{
    /* Read signal description out of memory buffer. */
    zb_zdo_app_signal_hdr_t *sg_p = NULL;
    zb_zdo_app_signal_type_t sig = zb_get_app_signal(bufid, &sg_p);
    zb_ret_t status = ZB_GET_APP_SIGNAL_STATUS(bufid);
    zb_ret_t zb_err_code;
    zb_bool_t comm_status;
    zb_time_t timeout_bi;

    switch (sig) {
    case ZB_BDB_SIGNAL_DEVICE_REBOOT:
        /* BDB initialization completed after device reboot,
         * use NVRAM contents during initialization.
         * Device joined/rejoined and started.
         */
        if (status == RET_OK) {
            if (ZIGBEE_MANUAL_STEERING == ZB_FALSE) {
                LOG_INF("Start network steering");
                comm_status = bdb_start_top_level_commissioning(
                    ZB_BDB_NETWORK_STEERING);
                ZB_COMM_STATUS_CHECK(comm_status);
            } else {
                LOG_INF("Coordinator restarted successfully");
            }
        } else {
            LOG_ERR("Failed to initialize Zigbee stack using NVRAM data (status: %d)",
                status);
        }
        break;

    case ZB_BDB_SIGNAL_STEERING:
        if (status == RET_OK) {
            if (ZIGBEE_PERMIT_LEGACY_DEVICES == ZB_TRUE) {
                LOG_INF("Allow pre-Zigbee 3.0 devices to join the network");
                zb_bdb_set_legacy_device_support(1);
            }

            /* Schedule an alarm to notify about the end of steering period.
             */
            LOG_INF("Network steering started");
            zb_err_code = ZB_SCHEDULE_APP_ALARM(
                steering_finished, 0,
                ZB_TIME_ONE_SECOND *
                ZB_ZGP_DEFAULT_COMMISSIONING_WINDOW);
            ZB_ERROR_CHECK(zb_err_code);
        }
        break;

    case ZB_ZDO_SIGNAL_DEVICE_ANNCE: {
        zb_zdo_signal_device_annce_params_t *dev_annce_params =
            ZB_ZDO_SIGNAL_GET_PARAMS(
                sg_p, zb_zdo_signal_device_annce_params_t);

        LOG_INF("New device commissioned or rejoined (short: 0x%04hx)",
            dev_annce_params->device_short_addr);

        zb_err_code = ZB_SCHEDULE_APP_ALARM_CANCEL(steering_finished, ZB_ALARM_ANY_PARAM);
        if (zb_err_code == RET_OK) {
            LOG_INF("Joining period extended.");
            zb_err_code = ZB_SCHEDULE_APP_ALARM(
                steering_finished, 0,
                ZB_TIME_ONE_SECOND *
                ZB_ZGP_DEFAULT_COMMISSIONING_WINDOW);
            ZB_ERROR_CHECK(zb_err_code);
        }
    } break;

    default:
        /* Call default signal handler. */
        ZB_ERROR_CHECK(zigbee_default_signal_handler(bufid));
        break;
    }

    /* Update network status LED. */
    if (ZB_JOINED() &&
        (ZB_SCHEDULE_GET_ALARM_TIME(steering_finished, ZB_ALARM_ANY_PARAM,
                    &timeout_bi) == RET_OK)) {
        dk_set_led_on(ZIGBEE_NETWORK_STATE_LED);
    } else {
        dk_set_led_off(ZIGBEE_NETWORK_STATE_LED);
    }

    /*
     * All callbacks should either reuse or free passed buffers.
     * If bufid == 0, the buffer is invalid (not passed).
     */
    if (bufid) {
        zb_buf_free(bufid);
    }
}

int main(void)
{
    int blink_status = 0;

    LOG_INF("Starting ZBOSS Coordinator example");

    /* Initialize */
    configure_gpio();
    register_factory_reset_button(FACTORY_RESET_BUTTON);

    /* Register device context (endpoints). */
    ZB_AF_REGISTER_DEVICE_CTX(&nwk_coordinator);

    app_clusters_attr_init();

    /* Register handlers to identify notifications. */
    ZB_AF_SET_IDENTIFY_NOTIFICATION_HANDLER(ZIGBEE_COORDINATOR_ENDPOINT, identify_cb);

    /* Start Zigbee default thread */
    zigbee_enable();

    LOG_INF("ZBOSS Coordinator example started");

    while (1) {
        dk_set_led(RUN_STATUS_LED, (++blink_status) % 2);
        k_sleep(K_MSEC(RUN_LED_BLINK_INTERVAL));
    }
}
```

## include/zb_range_extender.h
```c
/*
 * Copyright (c) 2022 Nordic Semiconductor ASA
 *
 * SPDX-License-Identifier: LicenseRef-Nordic-5-Clause
 */

#ifndef ZB_RANGE_EXTENDER_H
#define ZB_RANGE_EXTENDER_H 1

/**
 *  @defgroup ZB_DEFINE_DEVICE_RANGE_EXTENDER Range Extender
 *  @{
 *  @details
 *      - @ref ZB_ZCL_IDENTIFY \n
 *      - @ref ZB_ZCL_BASIC
 */

/** Range Extender Device ID*/
#define ZB_RANGE_EXTENDER_DEVICE_ID 0x0008

/** Range extender device version */
#define ZB_DEVICE_VER_RANGE_EXTENDER 0

/** @cond internals_doc */

/** Range extender IN (server) clusters number */
#define ZB_RANGE_EXTENDER_IN_CLUSTER_NUM 2

/** Range extender OUT (client) clusters number */
#define ZB_RANGE_EXTENDER_OUT_CLUSTER_NUM 0

#define ZB_RANGE_EXTENDER_CLUSTER_NUM \
    (ZB_RANGE_EXTENDER_IN_CLUSTER_NUM + ZB_RANGE_EXTENDER_OUT_CLUSTER_NUM)

/** Number of attribute for reporting on Range extender device */
#define ZB_RANGE_EXTENDER_REPORT_ATTR_COUNT 0

/** @endcond */ /* internals_doc */

/**
 * @brief Declare cluster list for Range extender device
 * @param cluster_list_name - cluster list variable name
 * @param basic_attr_list - attribute list for Basic cluster
 * @param identify_attr_list - attribute list for Identify cluster
 */
#define ZB_DECLARE_RANGE_EXTENDER_CLUSTER_LIST(   \
        cluster_list_name,                        \
        basic_attr_list,                          \
        identify_attr_list)                       \
zb_zcl_cluster_desc_t cluster_list_name[] =       \
{                                                 \
    ZB_ZCL_CLUSTER_DESC(                          \
        ZB_ZCL_CLUSTER_ID_IDENTIFY,               \
        ZB_ZCL_ARRAY_SIZE(identify_attr_list, zb_zcl_attr_t), \
        (identify_attr_list),                     \
        ZB_ZCL_CLUSTER_SERVER_ROLE,               \
        ZB_ZCL_MANUF_CODE_INVALID                 \
    ),                                            \
    ZB_ZCL_CLUSTER_DESC(                          \
        ZB_ZCL_CLUSTER_ID_BASIC,                  \
        ZB_ZCL_ARRAY_SIZE(basic_attr_list, zb_zcl_attr_t),    \
        (basic_attr_list),                        \
        ZB_ZCL_CLUSTER_SERVER_ROLE,               \
        ZB_ZCL_MANUF_CODE_INVALID                 \
    )                                             \
}

/** @cond internals_doc */

/**
 * @brief Declare simple descriptor for Range extender device
 * @param ep_name - endpoint variable name
 * @param ep_id - endpoint ID
 * @param in_clust_num - number of supported input clusters
 * @param out_clust_num - number of supported output clusters
 */
#define ZB_ZCL_DECLARE_RANGE_EXTENDER_SIMPLE_DESC(ep_name, ep_id, in_clust_num, out_clust_num) \
    ZB_DECLARE_SIMPLE_DESC(in_clust_num, out_clust_num);                                       \
    ZB_AF_SIMPLE_DESC_TYPE(in_clust_num, out_clust_num) simple_desc_##ep_name =                \
    {                                               \
        ep_id,                                      \
        ZB_AF_HA_PROFILE_ID,                        \
        ZB_RANGE_EXTENDER_DEVICE_ID,                \
        ZB_DEVICE_VER_RANGE_EXTENDER,               \
        0,                                          \
        in_clust_num,                               \
        out_clust_num,                              \
        {                                           \
            ZB_ZCL_CLUSTER_ID_BASIC,                \
            ZB_ZCL_CLUSTER_ID_IDENTIFY              \
        }                                           \
    }

/** @endcond */ /* internals_doc */

/**
 * @brief Declare endpoint for Range extender device
 * @param ep_name - endpoint variable name
 * @param ep_id - endpoint ID
 * @param cluster_list - endpoint cluster list
 */
#define ZB_DECLARE_RANGE_EXTENDER_EP(ep_name, ep_id, cluster_list)                \
    ZB_ZCL_DECLARE_RANGE_EXTENDER_SIMPLE_DESC(ep_name, ep_id,                     \
        ZB_RANGE_EXTENDER_IN_CLUSTER_NUM, ZB_RANGE_EXTENDER_OUT_CLUSTER_NUM);     \
    ZB_AF_DECLARE_ENDPOINT_DESC(ep_name, ep_id, ZB_AF_HA_PROFILE_ID, 0, NULL,     \
        ZB_ZCL_ARRAY_SIZE(cluster_list, zb_zcl_cluster_desc_t), cluster_list,     \
            (zb_af_simple_desc_1_1_t *)&simple_desc_##ep_name,                    \
            0, NULL, /* No reporting ctx */                                       \
            0, NULL) /* No CVC ctx */

/*! @} */

#endif /* ZB_RANGE_EXTENDER_H */
```
