## CMakeLists.txt
```
#
# Copyright (c) 2016-2023 Makerdiary
#
# SPDX-License-Identifier: Apache-2.0
#

cmake_minimum_required(VERSION 3.20.0)
find_package(Zephyr REQUIRED HINTS $ENV{ZEPHYR_BASE})
project(button)

FILE(GLOB app_sources src/*.c)
# NORDIC SDK APP START
target_sources(app  PRIVATE ${app_sources})
# NORDIC SDK APP END
```

## sample.yaml
```
sample:
  name: Button Sample
common:
  build_only: true
  integration_platforms:
    - connectkit_nrf52840
    - dongle_nrf52840
tests:
  sample.button: {}
```

## prj.conf
```kconfig
CONFIG_GPIO=y

CONFIG_USB_DEVICE_STACK=y
CONFIG_USB_DEVICE_PRODUCT="Zephyr USB console"
CONFIG_USB_DEVICE_PID=0x0004
CONFIG_USB_DEVICE_INITIALIZE_AT_BOOT=n

CONFIG_SERIAL=y
CONFIG_CONSOLE=y
CONFIG_UART_CONSOLE=y
CONFIG_UART_LINE_CTRL=y
```

## src/main.c
```c
/*
 * Copyright (c) 2016 Open-RnD Sp. z o.o.
 * Copyright (c) 2020 Nordic Semiconductor ASA
 * Copyright (c) 2016-2023 Makerdiary
 *
 * SPDX-License-Identifier: Apache-2.0
 */

#include <zephyr/kernel.h>
#include <zephyr/device.h>
#include <zephyr/drivers/gpio.h>
#include <zephyr/sys/util.h>
#include <zephyr/sys/printk.h>
#include <inttypes.h>

#define SLEEP_TIME_MS    1

/*
 * Get button configuration from the devicetree sw0 alias. This is mandatory.
 */
#define SW0_NODE    DT_ALIAS(sw0)
#if !DT_NODE_HAS_STATUS(SW0_NODE, okay)
#error "Unsupported board: sw0 devicetree alias is not defined"
#endif
static const struct gpio_dt_spec button = GPIO_DT_SPEC_GET_OR(SW0_NODE, gpios,
                                  {0});
static struct gpio_callback button_cb_data;

/*
 * The led0 devicetree alias is optional. If present, we'll use it
 * to turn on the LED whenever the button is pressed.
 */
static struct gpio_dt_spec led = GPIO_DT_SPEC_GET_OR(DT_ALIAS(led0), gpios,
                             {0});

void button_pressed(const struct device *dev, struct gpio_callback *cb,
            uint32_t pins)
{
    printk("Button pressed at %" PRIu32 "\n", k_cycle_get_32());
}

int main(void)
{
    int ret;

    if (!device_is_ready(button.port)) {
        printk("Error: button device %s is not ready\n",
               button.port->name);
        return 0;
    }

    ret = gpio_pin_configure_dt(&button, GPIO_INPUT);
    if (ret != 0) {
        printk("Error %d: failed to configure %s pin %d\n",
               ret, button.port->name, button.pin);
        return 0;
    }

    ret = gpio_pin_interrupt_configure_dt(&button,
                          GPIO_INT_EDGE_TO_ACTIVE);
    if (ret != 0) {
        printk("Error %d: failed to configure interrupt on %s pin %d\n",
            ret, button.port->name, button.pin);
        return 0;
    }

    gpio_init_callback(&button_cb_data, button_pressed, BIT(button.pin));
    gpio_add_callback(button.port, &button_cb_data);
    printk("Set up button at %s pin %d\n", button.port->name, button.pin);

    if (led.port && !device_is_ready(led.port)) {
        printk("Error %d: LED device %s is not ready; ignoring it\n",
               ret, led.port->name);
        led.port = NULL;
    }
    if (led.port) {
        ret = gpio_pin_configure_dt(&led, GPIO_OUTPUT);
        if (ret != 0) {
            printk("Error %d: failed to configure LED device %s pin %d\n",
                   ret, led.port->name, led.pin);
            led.port = NULL;
        } else {
            printk("Set up LED at %s pin %d\n", led.port->name, led.pin);
        }
    }

    printk("Press the button\n");
    if (led.port) {
        while (1) {
            /* If we have an LED, match its state to the button's. */
            int val = gpio_pin_get_dt(&button);

            if (val >= 0) {
                gpio_pin_set_dt(&led, val);
            }
            k_msleep(SLEEP_TIME_MS);
        }
    }
    return 0;
}
```

## src/pselreset_erase.c
```c
/*
 * Copyright (c) 2016-2023 Makerdiary
 *
 * SPDX-License-Identifier: Apache-2.0
 */

#include <zephyr/init.h>
#include <zephyr/kernel.h>

#if defined(CONFIG_BOARD_DONGLE_NRF52840) && !defined(CONFIG_GPIO_AS_PINRESET)

static int pselreset_erase(void)
{
    /* if PSELRESET[0,1] in UICR is connected, nRESET function is exposed on Button 0.
     * To use GPIO function on Button 0, PSELRESET[0,1] in UICR should be erased.
     * This function will erase PSELRESET[0,1] and keep other registers in UICR unchanged.
     */

    NRF_UICR_Type nrf_uicr;
    volatile uint32_t *addr = NULL;

    if (((NRF_UICR->PSELRESET[0] & UICR_PSELRESET_CONNECT_Msk) == (UICR_PSELRESET_CONNECT_Connected << UICR_PSELRESET_CONNECT_Pos)) || 
        ((NRF_UICR->PSELRESET[1] & UICR_PSELRESET_CONNECT_Msk) == (UICR_PSELRESET_CONNECT_Connected << UICR_PSELRESET_CONNECT_Pos))) {

        addr = NRF_UICR->NRFFW;
        for (int i = 0; i < ARRAY_SIZE(nrf_uicr.NRFFW); i++) {
            nrf_uicr.NRFFW[i] = *addr;
            while (NRF_NVMC->READY == NVMC_READY_READY_Busy) {
                ;
            }
            addr++;
        }

        addr = NRF_UICR->NRFHW;
        for (int i = 0; i < ARRAY_SIZE(nrf_uicr.NRFHW); i++) {
            nrf_uicr.NRFHW[i] = *addr;
            while (NRF_NVMC->READY == NVMC_READY_READY_Busy) {
                ;
            }
            addr++;
        }

        addr = NRF_UICR->CUSTOMER;
        for (int i = 0; i < ARRAY_SIZE(nrf_uicr.CUSTOMER); i++) {
            nrf_uicr.CUSTOMER[i] = *addr;
            while (NRF_NVMC->READY == NVMC_READY_READY_Busy) {
                ;
            }
            addr++;
        }

        nrf_uicr.PSELRESET[0] = NRF_UICR->PSELRESET[0];
        while (NRF_NVMC->READY == NVMC_READY_READY_Busy) {
            ;
        }

        nrf_uicr.PSELRESET[1] = NRF_UICR->PSELRESET[1];
        while (NRF_NVMC->READY == NVMC_READY_READY_Busy) {
            ;
        }

        nrf_uicr.APPROTECT = NRF_UICR->APPROTECT;
        while (NRF_NVMC->READY == NVMC_READY_READY_Busy) {
            ;
        }

        nrf_uicr.NFCPINS = NRF_UICR->NFCPINS;
        while (NRF_NVMC->READY == NVMC_READY_READY_Busy) {
            ;
        }

        nrf_uicr.DEBUGCTRL = NRF_UICR->DEBUGCTRL;
        while (NRF_NVMC->READY == NVMC_READY_READY_Busy) {
            ;
        }

        nrf_uicr.REGOUT0 = NRF_UICR->REGOUT0;
        while (NRF_NVMC->READY == NVMC_READY_READY_Busy) {
            ;
        }

        // Enable Erase mode
        NRF_NVMC->CONFIG = NVMC_CONFIG_WEN_Een << NVMC_CONFIG_WEN_Pos; // 0x02; 
        while (NRF_NVMC->READY == NVMC_READY_READY_Busy) {
            ;
        }

        // Erase the UICR registers
        NRF_NVMC->ERASEUICR = NVMC_ERASEUICR_ERASEUICR_Erase << NVMC_ERASEUICR_ERASEUICR_Pos; //0x00000001;
        while (NRF_NVMC->READY == NVMC_READY_READY_Busy) {
            ;
        }

        // Enable WRITE mode
        NRF_NVMC->CONFIG = NVMC_CONFIG_WEN_Wen << NVMC_CONFIG_WEN_Pos;
        while (NRF_NVMC->READY == NVMC_READY_READY_Busy) {
            ;
        }

        addr = NRF_UICR->NRFFW;
        for (int i = 0; i < ARRAY_SIZE(nrf_uicr.NRFFW); i++) {
            if (nrf_uicr.NRFFW[i] != 0xFFFFFFFF) {
                *addr = nrf_uicr.NRFFW[i];
                while (NRF_NVMC->READY == NVMC_READY_READY_Busy) {
                    ;
                }
            }
            addr++;
        }

        addr = NRF_UICR->NRFHW;
        for (int i = 0; i < ARRAY_SIZE(nrf_uicr.NRFHW); i++) {
            if (nrf_uicr.NRFHW[i] != 0xFFFFFFFF) {
                *addr = nrf_uicr.NRFHW[i];
                while (NRF_NVMC->READY == NVMC_READY_READY_Busy) {
                    ;
                }
            }
            addr++;
        }

        addr = NRF_UICR->CUSTOMER;
        for (int i = 0; i < ARRAY_SIZE(nrf_uicr.CUSTOMER); i++) {
            if (nrf_uicr.CUSTOMER[i] != 0xFFFFFFFF) {
                *addr = nrf_uicr.CUSTOMER[i];
                while (NRF_NVMC->READY == NVMC_READY_READY_Busy) {
                    ;
                }
            }
            addr++;
        }

        if (nrf_uicr.APPROTECT != 0xFFFFFFFF) {
            NRF_UICR->APPROTECT = nrf_uicr.APPROTECT;
            while (NRF_NVMC->READY == NVMC_READY_READY_Busy) {
                ;
            }
        }

        if (nrf_uicr.NFCPINS != 0xFFFFFFFF) {
            NRF_UICR->NFCPINS = nrf_uicr.NFCPINS;
            while (NRF_NVMC->READY == NVMC_READY_READY_Busy) {
                ;
            }
        }

        if (nrf_uicr.DEBUGCTRL != 0xFFFFFFFF) {
            NRF_UICR->DEBUGCTRL = nrf_uicr.DEBUGCTRL;
            while (NRF_NVMC->READY == NVMC_READY_READY_Busy) {
                ;
            }
        }

        if (nrf_uicr.REGOUT0 != 0xFFFFFFFF) {
            NRF_UICR->REGOUT0 = nrf_uicr.REGOUT0;
            while (NRF_NVMC->READY == NVMC_READY_READY_Busy) {
                ;
            }
        }
        
        /* a reset is required for changes to take effect */
        NVIC_SystemReset();
    }

    return 0;
}

SYS_INIT(pselreset_erase, PRE_KERNEL_1, CONFIG_KERNEL_INIT_PRIORITY_DEFAULT);

#endif /* CONFIG_BOARD_DONGLE_NRF52840 && !CONFIG_GPIO_AS_PINRESET */
```
