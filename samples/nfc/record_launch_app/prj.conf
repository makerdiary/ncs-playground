## CMakeLists.txt
```
#
# Copyright (c) 2021 Nordic Semiconductor
#
# SPDX-License-Identifier: LicenseRef-Nordic-5-Clause
#

cmake_minimum_required(VERSION 3.20.0)

find_package(Zephyr REQUIRED HINTS $ENV{ZEPHYR_BASE})
project(nfc_launch_app)

FILE(GLOB app_sources src/*.c)
# NORDIC SDK APP START
target_sources(app  PRIVATE ${app_sources})
# NORDIC SDK APP END
```

## sample.yaml
```
sample:
  name: NFC Launch App
common:
  build_only: true
  integration_platforms:
    - connectkit_nrf52840
tests:
  sample.nfc.launch_app: {}
```

## prj.conf
```kconfig
#
# Copyright (c) 2021 Nordic Semiconductor ASA
#
# SPDX-License-Identifier: LicenseRef-Nordic-5-Clause
#

CONFIG_REBOOT=y
CONFIG_GPIO=y

CONFIG_NFC_T2T_NRFXLIB=y

CONFIG_NFC_NDEF=y
CONFIG_NFC_NDEF_MSG=y
CONFIG_NFC_NDEF_RECORD=y
CONFIG_NFC_NDEF_URI_REC=y
CONFIG_NFC_NDEF_LAUNCHAPP_MSG=y
```

## src/main.c
```c
/*
 * Copyright (c) 2021 Nordic Semiconductor ASA
 * Copyright (c) 2016-2023 Makerdiary
 *
 * SPDX-License-Identifier: Apache-2.0
 */

#include <zephyr/kernel.h>
#include <zephyr/sys/reboot.h>
#include <zephyr/drivers/gpio.h>

#include <nfc_t2t_lib.h>
#include <nfc/ndef/launchapp_msg.h>

#define NDEF_MSG_BUF_SIZE    256

/* The devicetree node identifier for the "led0" alias. */
#define LED0_NODE DT_ALIAS(led0)

static const struct gpio_dt_spec led = GPIO_DT_SPEC_GET(LED0_NODE, gpios);

/* Package: no.nordicsemi.android.nrftoolbox */
static const uint8_t android_pkg_name[] = {
    'n', 'o', '.', 'n', 'o', 'r', 'd', 'i', 'c', 's', 'e', 'm', 'i', '.', 'a', 'n', 'd', 'r',
    'o', 'i', 'd', '.', 'n', 'r', 'f', 't', 'o', 'o', 'l', 'b', 'o', 'x' };

/* URI nrf-toolbox://main/ */
static const uint8_t universal_link[] = {
    'n', 'r', 'f', '-', 't', 'o', 'o', 'l', 'b', 'o', 'x', ':', '/', '/', 'm', 'a', 'i', 'n',
    '/'};

/* Buffer used to hold an NFC NDEF message. */
static uint8_t ndef_msg_buf[NDEF_MSG_BUF_SIZE];


static void nfc_callback(void *context,
             nfc_t2t_event_t event,
             const uint8_t *data,
             size_t data_length)
{
    ARG_UNUSED(context);
    ARG_UNUSED(data);
    ARG_UNUSED(data_length);

    switch (event) {
    case NFC_T2T_EVENT_FIELD_ON:
        gpio_pin_set_dt(&led, 1);
        break;
    case NFC_T2T_EVENT_FIELD_OFF:
        gpio_pin_set_dt(&led, 0);
        break;
    default:
        break;
    }
}

int main(void)
{
    int err;

    printk("Starting NFC Launch app sample\n");

    if (!device_is_ready(led.port)) {
        return -ENOTSUP;
    }

    err = gpio_pin_configure_dt(&led, GPIO_OUTPUT_INACTIVE);
    if (err < 0) {
        return err;
    }

    /* Set up NFC */
    err = nfc_t2t_setup(nfc_callback, NULL);
    if (err) {
        printk("Cannot setup NFC T2T library!\n");
        goto fail;
    }

    size_t len = sizeof(ndef_msg_buf);

    /* Encode launch app data  */
    err = nfc_launchapp_msg_encode(android_pkg_name,
                       sizeof(android_pkg_name),
                       universal_link,
                       sizeof(universal_link),
                       ndef_msg_buf,
                       &len);
    if (err) {
        printk("Cannot encode message!\n");
        goto fail;
    }

    /* Set created message as the NFC payload */
    err = nfc_t2t_payload_set(ndef_msg_buf, len);
    if (err) {
        printk("Cannot set payload!\n");
        goto fail;
    }

    /* Start sensing NFC field */
    err = nfc_t2t_emulation_start();
    if (err) {
        printk("Cannot start emulation!\n");
        goto fail;
    }

    printk("NFC configuration done\n");
    return 0;

fail:
#if CONFIG_REBOOT
    sys_reboot(SYS_REBOOT_COLD);
#endif /* CONFIG_REBOOT */

    return err;
}
```
