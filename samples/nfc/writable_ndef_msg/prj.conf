## CMakeLists.txt
```
#
# Copyright (c) 2018 Nordic Semiconductor
#
# SPDX-License-Identifier: LicenseRef-Nordic-5-Clause
#

cmake_minimum_required(VERSION 3.20.0)

find_package(Zephyr REQUIRED HINTS $ENV{ZEPHYR_BASE})
project(writable_ndef_msg)

FILE(GLOB app_sources src/*.c)
# NORDIC SDK APP START
target_sources(app  PRIVATE ${app_sources})
# NORDIC SDK APP END
```

## sample.yaml
```
sample:
  name: NFC Writable NDEF Message
common:
  build_only: true
  integration_platforms:
    - connectkit_nrf52840
tests:
  sample.nfc.writable_ndef_msg: {}
```

## prj.conf
```kconfig
#
# Copyright (c) 2019 Nordic Semiconductor ASA
# Copyright (c) 2016-2023 Makerdiary
#
# SPDX-License-Identifier: LicenseRef-Nordic-5-Clause
#

CONFIG_NFC_T4T_NRFXLIB=y

CONFIG_NFC_NDEF=y
CONFIG_NFC_NDEF_MSG=y
CONFIG_NFC_NDEF_RECORD=y
CONFIG_NFC_NDEF_URI_REC=y
CONFIG_NFC_NDEF_URI_MSG=y

CONFIG_MPU_ALLOW_FLASH_WRITE=y
CONFIG_FLASH=y
CONFIG_FLASH_PAGE_LAYOUT=y
CONFIG_NVS=y
CONFIG_DK_LIBRARY=y
```

## src/main.c
```c
/*
 * Copyright (c) 2018 Nordic Semiconductor ASA
 * Copyright (c) 2016-2023 Makerdiary
 *
 * SPDX-License-Identifier: LicenseRef-Nordic-5-Clause
 */

/** @file
 *
 * @defgroup nfc_writable_ndef_msg_example_main main.c
 * @{
 * @ingroup nfc_writable_ndef_msg_example
 * @brief The application main file of NFC writable NDEF message example.
 *
 */

#include <zephyr/kernel.h>
#include <zephyr/sys/reboot.h>
#include <stdbool.h>
#include <nfc_t4t_lib.h>

#include <nfc/ndef/msg.h>
#include <nfc/t4t/ndef_file.h>

#include <dk_buttons_and_leds.h>

#include "ndef_file_m.h"


#define NFC_FIELD_LED           0         /* Green LED */
#define NFC_WRITE_LED           1         /* RGB LED - RED */
#define NFC_READ_LED            3         /* RGB LED - BLUE */

#define NDEF_RESTORE_BTN_MSK    BIT(0)    /* USER Button */

static uint8_t ndef_msg_buf[CONFIG_NDEF_FILE_SIZE]; /**< Buffer for NDEF file. */

enum {
    FLASH_WRITE_FINISHED,
    FLASH_BUF_PREP_STARTED,
    FLASH_BUF_PREP_FINISHED,
    FLASH_WRITE_STARTED,
};
static atomic_t op_flags;
static uint8_t flash_buf[CONFIG_NDEF_FILE_SIZE]; /**< Buffer for flash update. */
static uint8_t flash_buf_len; /**< Length of the flash buffer. */

static void flash_buffer_prepare(size_t data_length)
{
    if (atomic_cas(&op_flags, FLASH_WRITE_FINISHED,
            FLASH_BUF_PREP_STARTED)) {
        flash_buf_len = data_length + NFC_NDEF_FILE_NLEN_FIELD_SIZE;
        memcpy(flash_buf, ndef_msg_buf, sizeof(flash_buf));

        atomic_set(&op_flags, FLASH_BUF_PREP_FINISHED);
    } else {
        printk("Flash update pending. Discarding new data...\n");
    }

}

/**
 * @brief Callback function for handling NFC events.
 */
static void nfc_callback(void *context,
             nfc_t4t_event_t event,
             const uint8_t *data,
             size_t data_length,
             uint32_t flags)
{
    ARG_UNUSED(context);
    ARG_UNUSED(data);
    ARG_UNUSED(flags);

    switch (event) {
    case NFC_T4T_EVENT_FIELD_ON:
        dk_set_led_on(NFC_FIELD_LED);
        break;

    case NFC_T4T_EVENT_FIELD_OFF:
        dk_set_leds(DK_NO_LEDS_MSK);
        break;

    case NFC_T4T_EVENT_NDEF_READ:
        dk_set_led_on(NFC_READ_LED);
        break;

    case NFC_T4T_EVENT_NDEF_UPDATED:
        if (data_length > 0) {
            dk_set_led_on(NFC_WRITE_LED);
            flash_buffer_prepare(data_length);
        }
        break;

    default:
        break;
    }
}

static int board_init(void)
{
    int err;

    err = dk_buttons_init(NULL);
    if (err) {
        printk("Cannot init buttons (err: %d)\n", err);
        return err;
    }

    err = dk_leds_init();
    if (err) {
        printk("Cannot init LEDs (err: %d)\n", err);
    }

    return err;
}

/**
 * @brief   Function for application main entry.
 */
int main(void)
{
    printk("Starting Nordic NFC Writable NDEF Message example\n");

    /* Configure LED-pins as outputs. */
    if (board_init() < 0) {
        printk("Cannot initialize board!\n");
        goto fail;
    }
    /* Initialize NVS. */
    if (ndef_file_setup() < 0) {
        printk("Cannot setup NDEF file!\n");
        goto fail;
    }
    /* Load NDEF message from the flash file. */
    if (ndef_file_load(ndef_msg_buf, sizeof(ndef_msg_buf)) < 0) {
        printk("Cannot load NDEF file!\n");
        goto fail;
    }

    /* Restore default NDEF message if button is pressed. */
    uint32_t button_state;

    dk_read_buttons(&button_state, NULL);
    if (button_state & NDEF_RESTORE_BTN_MSK) {
        if (ndef_restore_default(ndef_msg_buf,
                     sizeof(ndef_msg_buf)) < 0) {
            printk("Cannot flash NDEF message!\n");
            goto fail;
        }
        printk("Default NDEF message restored!\n");
    }
    /* Set up NFC */
    int err = nfc_t4t_setup(nfc_callback, NULL);

    if (err < 0) {
        printk("Cannot setup t4t library!\n");
        goto fail;
    }
    /* Run Read-Write mode for Type 4 Tag platform */
    if (nfc_t4t_ndef_rwpayload_set(ndef_msg_buf,
                       sizeof(ndef_msg_buf)) < 0) {
        printk("Cannot set payload!\n");
        goto fail;
    }
    /* Start sensing NFC field */
    if (nfc_t4t_emulation_start() < 0) {
        printk("Cannot start emulation!\n");
        goto fail;
    }
    printk("Starting NFC Writable NDEF Message example\n");

    while (true) {
        if (atomic_cas(&op_flags, FLASH_BUF_PREP_FINISHED,
                FLASH_WRITE_STARTED)) {
            if (ndef_file_update(flash_buf, flash_buf_len) < 0) {
                printk("Cannot flash NDEF message!\n");
            } else {
                printk("NDEF message successfully flashed.\n");
            }

            atomic_set(&op_flags, FLASH_WRITE_FINISHED);
        }

        __WFE();
    }

fail:
    #if CONFIG_REBOOT
        sys_reboot(SYS_REBOOT_COLD);
    #endif /* CONFIG_REBOOT */
        return -EIO;
}
/** @} */
```

## src/ndef_file_m.c
```c
/*
 * Copyright (c) 2018 Nordic Semiconductor ASA
 * Copyright (c) 2016-2023 Makerdiary
 *
 * SPDX-License-Identifier: LicenseRef-Nordic-5-Clause
 */

/** @file
 *
 * @ingroup nfc_writable_ndef_msg_example_ndef_file_m ndef_file_m.c
 * @{
 * @ingroup nfc_writable_ndef_msg_example
 * @brief FLASH service for the NFC writable NDEF message example.
 *
 */

#include <zephyr/kernel.h>
#include <soc.h>
#include <zephyr/device.h>
#include <string.h>
#include <zephyr/fs/nvs.h>
#include <nfc/t4t/ndef_file.h>
#include <nfc/ndef/uri_msg.h>
#include <zephyr/storage/flash_map.h>

#include "ndef_file_m.h"

#define FLASH_URL_ADDRESS_ID 1 /**< Address of URL message in FLASH */

static const uint8_t m_url[] = /**< Default NDEF message: URL "makerdiary.com". */
    {'m', 'a', 'k', 'e', 'r', 'd', 'i', 'a', 'r', 'y', '.', 'c', 'o', 'm'};

/* Flash partition for NVS */
#define NVS_FLASH_DEVICE FIXED_PARTITION_DEVICE(storage_partition)
/* Flash block size in bytes */
#define NVS_SECTOR_SIZE  (DT_PROP(DT_CHOSEN(zephyr_flash), erase_block_size))
#define NVS_SECTOR_COUNT 2
/* Start address of the filesystem in flash */
#define NVS_STORAGE_OFFSET FIXED_PARTITION_OFFSET(storage_partition)

static struct nvs_fs fs = {
    .sector_size = NVS_SECTOR_SIZE,
    .sector_count = NVS_SECTOR_COUNT,
    .offset = NVS_STORAGE_OFFSET,
};

int ndef_file_setup(void)
{
    int err;

    fs.flash_device = NVS_FLASH_DEVICE;
    if (fs.flash_device == NULL) {
        return -ENODEV;
    }

    err = nvs_mount(&fs);
    if (err < 0) {
        printk("Cannot initialize NVS!\n");
    }

    return err;
}

int ndef_file_update(uint8_t const *buff, uint32_t size)
{
    /* Update FLASH file with new NDEF message. */
    return nvs_write(&fs, FLASH_URL_ADDRESS_ID, buff, size);
}

/** .. include_startingpoint_ndef_file_rst */
int ndef_file_default_message(uint8_t *buff, uint32_t *size)
{
    int err;
    uint32_t ndef_size = nfc_t4t_ndef_file_msg_size_get(*size);

    /* Encode URI message into buffer. */
    err = nfc_ndef_uri_msg_encode(NFC_URI_HTTPS,
                      m_url,
                      sizeof(m_url),
                      nfc_t4t_ndef_file_msg_get(buff),
                      &ndef_size);
    if (err) {
        return err;
    }

    err = nfc_t4t_ndef_file_encode(buff, &ndef_size);
    if (err) {
        return err;
    }

    *size = ndef_size;

    return 0;
}
/** .. include_endpoint_ndef_file_rst */

int ndef_restore_default(uint8_t *buff, uint32_t size)
{
    int err;

    err = ndef_file_default_message(buff, &size);
    if (err < 0) {
        printk("Cannot create default message!\n");
        return err;
    }

    /* Save record with default NDEF message. */
    err = ndef_file_update(buff, size);
    if (err < 0) {
        printk("Cannot flash NDEF message!\n");
    }
    return err;
}

int ndef_file_load(uint8_t *buff, uint32_t size)
{
    int err;

    /* If there is no record with given ID, create default message and store
     * in FLASH. FLASH_URL_ADDRESS_ID is used to store an address, lets see
     * if we can read it from flash, since we don't know the size read the
     * maximum possible
     */
    err = nvs_read(&fs, FLASH_URL_ADDRESS_ID, buff, size);
    if (err > 0) { /* Item was found, show it */
        printk("Found NDEF file record.\n");
    } else {
        printk("NDEF file record not found, creating default NDEF.\n");
        /* Create default NDEF message. */
        err = ndef_restore_default(buff, size);
    }

    return err;
}

/** @} */
```

## src/nfcpins_enable.c
```c
/*
 * Copyright (c) 2016-2023 Makerdiary
 *
 * SPDX-License-Identifier: Apache-2.0
 */

#include <zephyr/init.h>
#include <zephyr/kernel.h>

#if defined(CONFIG_SOC_NRF52840_QIAA)

static int nfcpins_enable(const struct device *dev)
{
    ARG_UNUSED(dev);

    /* if NFCPINS in UICR is disabled, NFC functionality will be disabled.
     * To enable NFC, NFCPINS in UICR should be erased.
     * This function will erase NFCPINS and keep other registers in UICR unchanged.
     */

    NRF_UICR_Type nrf_uicr;
    volatile uint32_t *addr = NULL;

    if ((NRF_UICR->NFCPINS & UICR_NFCPINS_PROTECT_Msk) != (UICR_NFCPINS_PROTECT_NFC << UICR_NFCPINS_PROTECT_Pos)){

        addr = NRF_UICR->NRFFW;
        for (int i = 0; i < ARRAY_SIZE(nrf_uicr.NRFFW); i++) {
            nrf_uicr.NRFFW[i] = *addr;
            while (NRF_NVMC->READY == NVMC_READY_READY_Busy) {
                ;
            }
            addr++;
        }

        addr = NRF_UICR->NRFHW;
        for (int i = 0; i < ARRAY_SIZE(nrf_uicr.NRFHW); i++) {
            nrf_uicr.NRFHW[i] = *addr;
            while (NRF_NVMC->READY == NVMC_READY_READY_Busy) {
                ;
            }
            addr++;
        }

        addr = NRF_UICR->CUSTOMER;
        for (int i = 0; i < ARRAY_SIZE(nrf_uicr.CUSTOMER); i++) {
            nrf_uicr.CUSTOMER[i] = *addr;
            while (NRF_NVMC->READY == NVMC_READY_READY_Busy) {
                ;
            }
            addr++;
        }

        nrf_uicr.PSELRESET[0] = NRF_UICR->PSELRESET[0];
        while (NRF_NVMC->READY == NVMC_READY_READY_Busy) {
            ;
        }

        nrf_uicr.PSELRESET[1] = NRF_UICR->PSELRESET[1];
        while (NRF_NVMC->READY == NVMC_READY_READY_Busy) {
            ;
        }

        nrf_uicr.APPROTECT = NRF_UICR->APPROTECT;
        while (NRF_NVMC->READY == NVMC_READY_READY_Busy) {
            ;
        }

        nrf_uicr.NFCPINS = NRF_UICR->NFCPINS;
        while (NRF_NVMC->READY == NVMC_READY_READY_Busy) {
            ;
        }

        nrf_uicr.DEBUGCTRL = NRF_UICR->DEBUGCTRL;
        while (NRF_NVMC->READY == NVMC_READY_READY_Busy) {
            ;
        }

        nrf_uicr.REGOUT0 = NRF_UICR->REGOUT0;
        while (NRF_NVMC->READY == NVMC_READY_READY_Busy) {
            ;
        }

        // Enable Erase mode
        NRF_NVMC->CONFIG = NVMC_CONFIG_WEN_Een << NVMC_CONFIG_WEN_Pos; // 0x02; 
        while (NRF_NVMC->READY == NVMC_READY_READY_Busy) {
            ;
        }

        // Erase the UICR registers
        NRF_NVMC->ERASEUICR = NVMC_ERASEUICR_ERASEUICR_Erase << NVMC_ERASEUICR_ERASEUICR_Pos; //0x00000001;
        while (NRF_NVMC->READY == NVMC_READY_READY_Busy) {
            ;
        }

        // Enable WRITE mode
        NRF_NVMC->CONFIG = NVMC_CONFIG_WEN_Wen << NVMC_CONFIG_WEN_Pos;
        while (NRF_NVMC->READY == NVMC_READY_READY_Busy) {
            ;
        }

        addr = NRF_UICR->NRFFW;
        for (int i = 0; i < ARRAY_SIZE(nrf_uicr.NRFFW); i++) {
            if (nrf_uicr.NRFFW[i] != 0xFFFFFFFF) {
                *addr = nrf_uicr.NRFFW[i];
                while (NRF_NVMC->READY == NVMC_READY_READY_Busy) {
                    ;
                }
            }
            addr++;
        }

        addr = NRF_UICR->NRFHW;
        for (int i = 0; i < ARRAY_SIZE(nrf_uicr.NRFHW); i++) {
            if (nrf_uicr.NRFHW[i] != 0xFFFFFFFF) {
                *addr = nrf_uicr.NRFHW[i];
                while (NRF_NVMC->READY == NVMC_READY_READY_Busy) {
                    ;
                }
            }
            addr++;
        }

        addr = NRF_UICR->CUSTOMER;
        for (int i = 0; i < ARRAY_SIZE(nrf_uicr.CUSTOMER); i++) {
            if (nrf_uicr.CUSTOMER[i] != 0xFFFFFFFF) {
                *addr = nrf_uicr.CUSTOMER[i];
                while (NRF_NVMC->READY == NVMC_READY_READY_Busy) {
                    ;
                }
            }
            addr++;
        }

        if (nrf_uicr.PSELRESET[0] != 0xFFFFFFFF) {
            NRF_UICR->PSELRESET[0] = nrf_uicr.PSELRESET[0];
            while (NRF_NVMC->READY == NVMC_READY_READY_Busy) {
                ;
            }
        }

        if (nrf_uicr.PSELRESET[1] != 0xFFFFFFFF) {
            NRF_UICR->PSELRESET[1] = nrf_uicr.PSELRESET[1];
            while (NRF_NVMC->READY == NVMC_READY_READY_Busy) {
                ;
            }
        }

        if (nrf_uicr.APPROTECT != 0xFFFFFFFF) {
            NRF_UICR->APPROTECT = nrf_uicr.APPROTECT;
            while (NRF_NVMC->READY == NVMC_READY_READY_Busy) {
                ;
            }
        }

        if (nrf_uicr.DEBUGCTRL != 0xFFFFFFFF) {
            NRF_UICR->DEBUGCTRL = nrf_uicr.DEBUGCTRL;
            while (NRF_NVMC->READY == NVMC_READY_READY_Busy) {
                ;
            }
        }

        if (nrf_uicr.REGOUT0 != 0xFFFFFFFF) {
            NRF_UICR->REGOUT0 = nrf_uicr.REGOUT0;
            while (NRF_NVMC->READY == NVMC_READY_READY_Busy) {
                ;
            }
        }
        
        /* a reset is required for changes to take effect */
        NVIC_SystemReset();
    }

    return 0;
}

SYS_INIT(nfcpins_enable, PRE_KERNEL_1, CONFIG_KERNEL_INIT_PRIORITY_DEFAULT);

#endif /* CONFIG_SOC_NRF52840_QIAA */
```
