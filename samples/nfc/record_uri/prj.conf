## CMakeLists.txt
```
#
# Copyright (c) 2021 Nordic Semiconductor
#
# SPDX-License-Identifier: LicenseRef-Nordic-5-Clause
#

cmake_minimum_required(VERSION 3.20.0)

find_package(Zephyr REQUIRED HINTS $ENV{ZEPHYR_BASE})
project(nfc_record_uri)

FILE(GLOB app_sources src/*.c)
# NORDIC SDK APP START
target_sources(app  PRIVATE ${app_sources})
# NORDIC SDK APP END
```

## sample.yaml
```
sample:
  name: NFC Records URI
common:
  build_only: true
  integration_platforms:
    - connectkit_nrf52840
tests:
  sample.nfc.record_uri: {}
```

## prj.conf
```kconfig
#
# Copyright (c) 2021 Nordic Semiconductor ASA
#
# SPDX-License-Identifier: LicenseRef-Nordic-5-Clause
#

CONFIG_REBOOT=y
CONFIG_GPIO=y

CONFIG_NFC_T2T_NRFXLIB=y

CONFIG_NFC_NDEF=y
CONFIG_NFC_NDEF_MSG=y
CONFIG_NFC_NDEF_RECORD=y
CONFIG_NFC_NDEF_URI_MSG=y
CONFIG_NFC_NDEF_URI_REC=y
```

## src/main.c
```c
/*
 * Copyright (c) 2021 Nordic Semiconductor ASA
 * Copyright (c) 2016-2023 Makerdiary
 *
 * SPDX-License-Identifier: Apache-2.0
 */

#include <zephyr/kernel.h>
#include <zephyr/sys/reboot.h>
#include <zephyr/drivers/gpio.h>

#include <nfc_t2t_lib.h>
#include <nfc/ndef/uri_msg.h>

#define NDEF_MSG_BUF_SIZE    256

/* The devicetree node identifier for the "led0" alias. */
#define LED0_NODE DT_ALIAS(led0)

static const struct gpio_dt_spec led = GPIO_DT_SPEC_GET(LED0_NODE, gpios);

/* URL makerdiary.com */
static const uint8_t m_url[] =
    {'m', 'a', 'k', 'e', 'r', 'd', 'i', 'a', 'r', 'y', '.', 'c', 'o', 'm'}; //URL "makerdiary.com"

/* Buffer used to hold an NFC NDEF message. */
static uint8_t ndef_msg_buf[NDEF_MSG_BUF_SIZE];


static void nfc_callback(void *context,
             nfc_t2t_event_t event,
             const uint8_t *data,
             size_t data_length)
{
    ARG_UNUSED(context);
    ARG_UNUSED(data);
    ARG_UNUSED(data_length);

    switch (event) {
    case NFC_T2T_EVENT_FIELD_ON:
        gpio_pin_set_dt(&led, 1);
        break;
    case NFC_T2T_EVENT_FIELD_OFF:
        gpio_pin_set_dt(&led, 0);
        break;
    default:
        break;
    }
}

int main(void)
{
    int err;

    printk("Starting NFC URI record sample\n");

    if (!device_is_ready(led.port)) {
        return -ENOTSUP;
    }

    err = gpio_pin_configure_dt(&led, GPIO_OUTPUT_INACTIVE);
    if (err < 0) {
        return err;
    }

    /* Set up NFC */
    err = nfc_t2t_setup(nfc_callback, NULL);
    if (err) {
        printk("Cannot setup NFC T2T library!\n");
        goto fail;
    }

    /* Provide information about available buffer size to encoding function */
    size_t len = sizeof(ndef_msg_buf);

    /* Encode URI message into buffer */
    err = nfc_ndef_uri_msg_encode( NFC_URI_HTTPS,
                                   m_url,
                                   sizeof(m_url),
                                   ndef_msg_buf,
                                   &len);

    if (err) {
        printk("Cannot encode message!\n");
        goto fail;
    }

    /* Set created message as the NFC payload */
    err = nfc_t2t_payload_set(ndef_msg_buf, len);
    if (err) {
        printk("Cannot set payload!\n");
        goto fail;
    }

    /* Start sensing NFC field */
    err = nfc_t2t_emulation_start();
    if (err) {
        printk("Cannot start emulation!\n");
        goto fail;
    }

    printk("NFC configuration done\n");
    return 0;

fail:
#if CONFIG_REBOOT
    sys_reboot(SYS_REBOOT_COLD);
#endif /* CONFIG_REBOOT */

    return err;
}
```

## src/nfcpins_enable.c
```c
/*
 * Copyright (c) 2016-2023 Makerdiary
 *
 * SPDX-License-Identifier: Apache-2.0
 */

#include <zephyr/init.h>
#include <zephyr/kernel.h>

#if defined(CONFIG_SOC_NRF52840_QIAA)

static int nfcpins_enable(void)
{
    /* if NFCPINS in UICR is disabled, NFC functionality will be disabled.
     * To enable NFC, NFCPINS in UICR should be erased.
     * This function will erase NFCPINS and keep other registers in UICR unchanged.
     */

    NRF_UICR_Type nrf_uicr;
    volatile uint32_t *addr = NULL;

    if ((NRF_UICR->NFCPINS & UICR_NFCPINS_PROTECT_Msk) != (UICR_NFCPINS_PROTECT_NFC << UICR_NFCPINS_PROTECT_Pos)){

        addr = NRF_UICR->NRFFW;
        for (int i = 0; i < ARRAY_SIZE(nrf_uicr.NRFFW); i++) {
            nrf_uicr.NRFFW[i] = *addr;
            while (NRF_NVMC->READY == NVMC_READY_READY_Busy) {
                ;
            }
            addr++;
        }

        addr = NRF_UICR->NRFHW;
        for (int i = 0; i < ARRAY_SIZE(nrf_uicr.NRFHW); i++) {
            nrf_uicr.NRFHW[i] = *addr;
            while (NRF_NVMC->READY == NVMC_READY_READY_Busy) {
                ;
            }
            addr++;
        }

        addr = NRF_UICR->CUSTOMER;
        for (int i = 0; i < ARRAY_SIZE(nrf_uicr.CUSTOMER); i++) {
            nrf_uicr.CUSTOMER[i] = *addr;
            while (NRF_NVMC->READY == NVMC_READY_READY_Busy) {
                ;
            }
            addr++;
        }

        nrf_uicr.PSELRESET[0] = NRF_UICR->PSELRESET[0];
        while (NRF_NVMC->READY == NVMC_READY_READY_Busy) {
            ;
        }

        nrf_uicr.PSELRESET[1] = NRF_UICR->PSELRESET[1];
        while (NRF_NVMC->READY == NVMC_READY_READY_Busy) {
            ;
        }

        nrf_uicr.APPROTECT = NRF_UICR->APPROTECT;
        while (NRF_NVMC->READY == NVMC_READY_READY_Busy) {
            ;
        }

        nrf_uicr.NFCPINS = NRF_UICR->NFCPINS;
        while (NRF_NVMC->READY == NVMC_READY_READY_Busy) {
            ;
        }

        nrf_uicr.DEBUGCTRL = NRF_UICR->DEBUGCTRL;
        while (NRF_NVMC->READY == NVMC_READY_READY_Busy) {
            ;
        }

        nrf_uicr.REGOUT0 = NRF_UICR->REGOUT0;
        while (NRF_NVMC->READY == NVMC_READY_READY_Busy) {
            ;
        }

        // Enable Erase mode
        NRF_NVMC->CONFIG = NVMC_CONFIG_WEN_Een << NVMC_CONFIG_WEN_Pos; // 0x02; 
        while (NRF_NVMC->READY == NVMC_READY_READY_Busy) {
            ;
        }

        // Erase the UICR registers
        NRF_NVMC->ERASEUICR = NVMC_ERASEUICR_ERASEUICR_Erase << NVMC_ERASEUICR_ERASEUICR_Pos; //0x00000001;
        while (NRF_NVMC->READY == NVMC_READY_READY_Busy) {
            ;
        }

        // Enable WRITE mode
        NRF_NVMC->CONFIG = NVMC_CONFIG_WEN_Wen << NVMC_CONFIG_WEN_Pos;
        while (NRF_NVMC->READY == NVMC_READY_READY_Busy) {
            ;
        }

        addr = NRF_UICR->NRFFW;
        for (int i = 0; i < ARRAY_SIZE(nrf_uicr.NRFFW); i++) {
            if (nrf_uicr.NRFFW[i] != 0xFFFFFFFF) {
                *addr = nrf_uicr.NRFFW[i];
                while (NRF_NVMC->READY == NVMC_READY_READY_Busy) {
                    ;
                }
            }
            addr++;
        }

        addr = NRF_UICR->NRFHW;
        for (int i = 0; i < ARRAY_SIZE(nrf_uicr.NRFHW); i++) {
            if (nrf_uicr.NRFHW[i] != 0xFFFFFFFF) {
                *addr = nrf_uicr.NRFHW[i];
                while (NRF_NVMC->READY == NVMC_READY_READY_Busy) {
                    ;
                }
            }
            addr++;
        }

        addr = NRF_UICR->CUSTOMER;
        for (int i = 0; i < ARRAY_SIZE(nrf_uicr.CUSTOMER); i++) {
            if (nrf_uicr.CUSTOMER[i] != 0xFFFFFFFF) {
                *addr = nrf_uicr.CUSTOMER[i];
                while (NRF_NVMC->READY == NVMC_READY_READY_Busy) {
                    ;
                }
            }
            addr++;
        }

        if (nrf_uicr.PSELRESET[0] != 0xFFFFFFFF) {
            NRF_UICR->PSELRESET[0] = nrf_uicr.PSELRESET[0];
            while (NRF_NVMC->READY == NVMC_READY_READY_Busy) {
                ;
            }
        }

        if (nrf_uicr.PSELRESET[1] != 0xFFFFFFFF) {
            NRF_UICR->PSELRESET[1] = nrf_uicr.PSELRESET[1];
            while (NRF_NVMC->READY == NVMC_READY_READY_Busy) {
                ;
            }
        }

        if (nrf_uicr.APPROTECT != 0xFFFFFFFF) {
            NRF_UICR->APPROTECT = nrf_uicr.APPROTECT;
            while (NRF_NVMC->READY == NVMC_READY_READY_Busy) {
                ;
            }
        }

        if (nrf_uicr.DEBUGCTRL != 0xFFFFFFFF) {
            NRF_UICR->DEBUGCTRL = nrf_uicr.DEBUGCTRL;
            while (NRF_NVMC->READY == NVMC_READY_READY_Busy) {
                ;
            }
        }

        if (nrf_uicr.REGOUT0 != 0xFFFFFFFF) {
            NRF_UICR->REGOUT0 = nrf_uicr.REGOUT0;
            while (NRF_NVMC->READY == NVMC_READY_READY_Busy) {
                ;
            }
        }
        
        /* a reset is required for changes to take effect */
        NVIC_SystemReset();
    }

    return 0;
}

SYS_INIT(nfcpins_enable, PRE_KERNEL_1, CONFIG_KERNEL_INIT_PRIORITY_DEFAULT);

#endif /* CONFIG_SOC_NRF52840_QIAA */
```
